## components/auto_off/KConfig
```kconfig
menu "Auto Off"
    config AUTO_OFF
        bool "Auto Off"
        default n
        help
            Switches the light off by itself after a period without operation (REQ_39).

    config AUTO_OFF_TIMEOUT
        int "Auto Off timeout (in seconds)"
        depends on AUTO_OFF
        default 10
        range 5 7200
        help
            The light switches off after this many seconds without operation (REQ_39).
            The value can be set between 5 and 7200 seconds.
endmenu
```
